## meta-ynov-rpi4/conf/layer.conf
```bitbake
# We have a conf and classes directory, add to BBPATH
BBPATH .= ":${LAYERDIR}"

# We have recipes-* directories, add to BBFILES
BBFILES += "${LAYERDIR}/recipes-*/*/*.bb \
            ${LAYERDIR}/recipes-*/*/*.bbappend"

BBFILE_COLLECTIONS += "meta-ynov-rpi4"
BBFILE_PATTERN_meta-ynov-rpi4 = "^${LAYERDIR}/"
BBFILE_PRIORITY_meta-ynov-rpi4 = "6"

LAYERDEPENDS_meta-ynov-rpi4 = "core"
LAYERSERIES_COMPAT_meta-ynov-rpi4 = "gatesgarth"
```
